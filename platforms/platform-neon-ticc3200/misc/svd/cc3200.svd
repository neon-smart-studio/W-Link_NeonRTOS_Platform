# CC3200 register map
Vendor: Texas Instruments; Series: SimpleLink; File version: 1.0
CPU: CM4 r0p1, little endian, MPU, no FPU, 3 interrupt priority bits
Registers are 32-bit, read-write, reset 0x0 unless marked. A register's access mark holds for its fields unless they carry their own. Offsets are from the block's base; [hi:lo] are bit positions; {n}, {i} and the like mark numbered series.

## COMMON_REG
Base 0x400F7000
0x00 I2C_Properties_Register — COMMON_REG_I2C_Properties_Register
  [1:0] I2C_Properties_Register_M
0x04 SPI_Properties_Register — COMMON_REG_SPI_Properties_Register
  [1:0] SPI_Properties_Register_M
0x0C APPS_sh_resource_Interrupt_enable — COMMON_REG_APPS_sh_resource_Interrupt_enable
  [3:0] APPS_sh_resource_Interrupt_enable_M
0x10 APPS_sh_resource_Interrupt_status — COMMON_REG_APPS_sh_resource_Interrupt_status
  [3:0] APPS_sh_resource_Interrupt_status_M
0x14 NWP_sh_resource_Interrupt_enable — COMMON_REG_NWP_sh_resource_Interrupt_enable
  [3:0] NWP_sh_resource_Interrupt_enable_M
0x18 NWP_sh_resource_Interrupt_status — COMMON_REG_NWP_sh_resource_Interrupt_status
  [3:0] NWP_sh_resource_Interrupt_status_M
0x1C Flash_ctrl_reg — COMMON_REG_Flash_ctrl_reg
  [1:0] Flash_ctrl_reg_M
{0x24+4i} Bus_matrix_M{i}_segment_access_config (i=0..5) — COMMON_REG_Bus_matrix_M{i}_segment_access_config
  [17:0] Bus_matrix_M{i}_segment_access_config_M
0x3C GPIO_properties_register — COMMON_REG_GPIO_properties_register
  [9:0] GPIO_properties_register_M
0x40 APPS_NW_SEMAPHORE1 — COMMON_REG_APPS_NW_SEMAPHORE1
  [31:0] APPS_NW_SEMAPHORE1_M — COMMON_REG_APPS_NW_SEMAPHORE1
  [31:0] _APPS_NW_SEMAPHORE10_M — COMMON_REG_APPS_NW_SEMAPHORE1
  [31:0] _APPS_NW_SEMAPHORE11_M — COMMON_REG_APPS_NW_SEMAPHORE1
  [31:0] _APPS_NW_SEMAPHORE12_M — COMMON_REG_APPS_NW_SEMAPHORE1
{0x3C+4i} APPS_NW_SEMAPHORE{i} (i=2..12) — COMMON_REG_APPS_NW_SEMAPHORE{i}
  [31:0] APPS_NW_SEMAPHORE{i}_M
0x70 APPS_SEMAPPHORE_PEND — COMMON_REG_APPS_SEMAPPHORE_PEND
  [31:0] APPS_SEMAPPHORE_PEND_M
0x74 NW_SEMAPPHORE_PEND — COMMON_REG_NW_SEMAPPHORE_PEND
  [31:0] NW_SEMAPPHORE_PEND_M
0x78 SEMAPHORE_STATUS — COMMON_REG_SEMAPHORE_STATUS
  [31:0] SEMAPHORE_STATUS_M — COMMON_REG_SEMAPHORE_STATUS
  [23:0] _SEMPAPHORE_STATUS2_M — COMMON_REG_SEMAPHORE_STATUS
0x7C IDMEM_TIM_Update — COMMON_REG_IDMEM_TIM_Update
  [0] _TIM_UPDATED
0x80 FPGA_ROM_WR_EN — COMMON_REG_FPGA_ROM_WR_EN
  [0] FPGA_ROM_WR_EN
0x84 NW_INT_MASK — COMMON_REG_NW_INT_MASK
  [31:0] CLR_NW_INT_MASK_CLR_M — COMMON_REG_NW_INT_MASK
  [31:0] NW_INT_MASK_M — COMMON_REG_NW_INT_MASK
  [31:0] SET_NW_INT_MASK_SET_M — COMMON_REG_NW_INT_MASK
0x88 NW_INT_MASK_SET — COMMON_REG_NW_INT_MASK_SET
  [31:0] NW_INT_MASK_SET_M
0x8C NW_INT_MASK_CLR — COMMON_REG_NW_INT_MASK_CLR
  [31:0] NW_INT_MASK_CLR_M
0x90 NW_INT_STS_CLR — COMMON_REG_NW_INT_STS_CLR
  [31:0] NW_INT_STS_CLR_M
0x94 NW_INT_ACK — COMMON_REG_NW_INT_ACK
  [31:0] NW_INT_ACK_M
0x98 NW_INT_TRIG — COMMON_REG_NW_INT_TRIG
  [31:0] NW_INT_TRIG_M
0x9C NW_INT_STS_MASKED — COMMON_REG_NW_INT_STS_MASKED
  [31:0] NW_INT_STS_MASKED_M
0xA0 NW_INT_STS_RAW — COMMON_REG_NW_INT_STS_RAW
  [31:0] NW_INT_STS_RAW_M
0xA4 APPS_INT_MASK — COMMON_REG_APPS_INT_MASK
  [31:0] APPS_INT_MASK_M — COMMON_REG_APPS_INT_MASK
  [31:0] CLR_APPS_INT_MASK_CLR_M — COMMON_REG_APPS_INT_MASK
  [31:0] SET_APPS_INT_MASK_SET_M — COMMON_REG_APPS_INT_MASK
0xA8 APPS_INT_MASK_SET — COMMON_REG_APPS_INT_MASK_SET
  [31:0] APPS_INT_MASK_SET_M
0xAC APPS_INT_MASK_CLR — COMMON_REG_APPS_INT_MASK_CLR
  [31:0] APPS_INT_MASK_CLR_M
0xB0 APPS_INT_STS_CLR — COMMON_REG_APPS_INT_STS_CLR
  [31:0] APPS_INT_STS_CLR_M
0xB4 APPS_INT_ACK — COMMON_REG_APPS_INT_ACK
  [31:0] APPS_INT_ACK_M
0xB8 APPS_INT_TRIG — COMMON_REG_APPS_INT_TRIG
  [31:0] APPS_INT_TRIG_M
0xBC APPS_INT_STS_MASKED — COMMON_REG_APPS_INT_STS_MASKED
  [31:0] APPS_INT_STS_MASKED_M
0xC0 APPS_INT_STS_RAW — COMMON_REG_APPS_INT_STS_RAW
  [31:0] APPS_INT_STS_RAW_M
0xC4 IDMEM_TIM_Updated — COMMON_REG_IDMEM_TIM_Updated
  [0] TIM_UPDATED
0xC8 APPS_GPIO_TRIG_EN — COMMON_REG_APPS_GPIO_TRIG_EN
  [4:0] APPS_GPIO_TRIG_EN_M
0xCC EMU_DEBUG_REG — COMMON_REG_EMU_DEBUG_REG
  [31:0] EMU_DEBUG_REG_M
0xD0 SEMAPHORE_STATUS2 — COMMON_REG_SEMAPHORE_STATUS2
  [23:0] SEMPAPHORE_STATUS2_M
0xD4 SEMAPHORE_PREV_OWNER1 — COMMON_REG_SEMAPHORE_PREV_OWNER1
  [17:0] SEMAPHORE_PREV_OWNER1_M
0xD8 SEMAPHORE_PREV_OWNER2 — COMMON_REG_SEMAPHORE_PREV_OWNER2
  [23:0] SEMAPHORE_PREV_OWNER2_M
